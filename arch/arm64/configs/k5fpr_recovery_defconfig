## drivers/misc/mediatek/base/power/mt6735/Kconfig
```kconfig
config CPU_DVFS_SYSTEM_BOOTUP_BOOST
	bool "cpu dvfs system bootup boost"
	default y
	depends on MT_BOOT_TIME_CPU_BOOST
	help
		CPU_DVFS_SYSTEM_BOOTUP_BOOST is used to enhance system bootup time by fixing
		CPU at max CPU frequency before bootup procedure finished. Say y here to enable
		it and say n to disable it.

config MTK_VOLTAGE_TABLE
	tristate "Enable CPU Voltage Table via sysfs for adjustements"
	depends on CPU_FREQ
	default n
	help
	  This drivers lets the user change the dvfs voltage table for the cpu
	  If in doubt, say N.
```

## drivers/misc/mediatek/nfc/Kconfig
```kconfig
menuconfig MTK_NFC
	tristate "NFC drivers"
	depends on !MTK_ENABLE_GMO
	default n
	---help---
	  Say Y here for supporting NFC.
	  Say Y here for supporting NFC.
	  Say Y here for supporting NFC.

if MTK_NFC

config NFC_MT6605
	tristate "MediaTek NFC driver"
	depends on !MTK_ENABLE_GMO
	default n
	help
	  Y means NFC_MT6605 define if use Mediatek NFC Function to provide reader
	  Card emulation or P2P function. If you are not sure about this, set n.
	  Y means NFC_MT6605 define if use Mediatek NFC Function to provide reader
	  Card emulation or P2P function. If you are not sure about this, set n.

config NFC_MSR3110
	tristate "MSR3110 NFC driver"
	default n
	help
	  Y means NFC_MSR3110 define if use MSTAR NFC Function to provide reader
	  Card emulation or P2P function. If you are not sure about this, set n.

endif # NFC
```
